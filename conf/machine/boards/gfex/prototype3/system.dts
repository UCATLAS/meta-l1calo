/*
 * CAUTION: This file is automatically generated by Xilinx.
 * Version:  
 * Today is: Wed Nov 15 16:54:58 2017
*/


&gem2 {
	local-mac-address = [00 0a 35 00 00 00];
};
&gem3 {
	local-mac-address = [00 0a 35 00 00 01];
};

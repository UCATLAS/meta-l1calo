## conf/layer.conf
```bitbake
# We might have a conf and classes directory, append to BBPATH
BBPATH .= ":${LAYERDIR}"

# We have recipes directories, add to BBFILES
BBFILES += "${LAYERDIR}/recipes*/*/*/*.bbappend"
BBFILES += "${LAYERDIR}/recipes*/*/*.bb"
BBFILES += "${LAYERDIR}/recipes*/*/*.bbappend"
BBFILES += "${LAYERDIR}/recipes*/*.bb"
BBFILES += "${LAYERDIR}/recipes*/*.bbappend"

BBFILE_COLLECTIONS += "l1calo"
BBFILE_PATTERN_l1calo := "^${LAYERDIR}/"
BBFILE_PRIORITY_l1calo = "7"

# This should only be incremented on significant changes that will
# cause compatibility issues with other layers
LAYERVERSION_l1calo = "2"

# Note: meta-virtualization has 3.11 for python-pyyaml, but not needed hopefully as 3.10 should be fine
LAYERDEPENDS_l1calo = "core openembedded-layer meta-python xilinx"

LAYERSERIES_COMPAT_l1calo = "langdale"
```

## conf/machine/gfex-production-p1.conf
```bitbake
#@TYPE: Machine
#@NAME: Prototype 4
#@DESCRIPTION: Machine support for gFEX Prototype 4

require conf/machine/include/tune-gfex-zynqmp.inc
#UBOOT_MACHINE := "gcm-zynqmp_defconfig"
UBOOT_MACHINE := "xilinx_zynqmp_virt_defconfig"
# add MACHINEOVERRIDES .= ":zcu102-zynqmp" to your machine config otherwise those
# overrides in recipes won't apply since the machine name is different
MACHINEOVERRIDES .= ":gfex-production-p1"
MACHINEOVERRIDES .= ":gfex-production"
MACHINEOVERRIDES .= ":gfex-prototype4"
```

## conf/machine/gfex-prototype1b.conf
```bitbake
#@TYPE: Machine
#@NAME: Prototype 1B
#@DESCRIPTION: Machine support for gFEX Prototype 1b

require conf/machine/include/tune-gfex-zynq.inc
UBOOT_MACHINE := "gfex-prototype1b_defconfig"

# add MACHINEOVERRIDES .= ":zc706-zynq7" to your machine config otherwise those
# overrides in recipes won't apply since the machine name is different
MACHINEOVERRIDES .= ":gfex-prototype1"
```

## conf/machine/gfex-prototype2.conf
```bitbake
#@TYPE: Machine
#@NAME: Prototype 2
#@DESCRIPTION: Machine support for gFEX Prototype 2 for integration tests at CERN, late 2016

require conf/machine/include/tune-gfex-zynq.inc
UBOOT_MACHINE := "gfex-prototype2_defconfig"

# add MACHINEOVERRIDES .= ":zc706-zynq7" to your machine config otherwise those
# overrides in recipes won't apply since the machine name is different
MACHINEOVERRIDES .= ":gfex-prototype2"
```

## conf/machine/gfex-prototype3.conf
```bitbake
#@TYPE: Machine
#@NAME: Prototype 3
#@DESCRIPTION: Machine support for gFEX Prototype 3 for Installation and Commisisioning at CERN, early 2018

# add MACHINEOVERRIDES .= ":zcu102-zynqmp" to your machine config otherwise those
# overrides in recipes won't apply since the machine name is different
require conf/machine/zcu102-zynqmp.conf

MACHINEOVERRIDES .= ":zcu102-zynqmp"
UBOOT_MACHINE := "gfex-prototype3_defconfig"
```

## conf/machine/gfex-prototype3a.conf
```bitbake
#@TYPE: Machine
#@NAME: Prototype 3a
#@DESCRIPTION: Machine support for gFEX Prototype 3a for BNL testing 

require conf/machine/include/tune-gfex-zynqmp.inc
UBOOT_MACHINE := "gfex-prototype3a_defconfig"

# add MACHINEOVERRIDES .= ":zcu102-zynqmp" to your machine config otherwise those
# overrides in recipes won't apply since the machine name is different
MACHINEOVERRIDES .= ":gfex-prototype3"
```

## conf/machine/gfex-prototype3b.conf
```bitbake
#@TYPE: Machine
#@NAME: Prototype 3b
#@DESCRIPTION: Machine support for gFEX Prototype 3b for Installation and Commisisioning at CERN, early 2018

require conf/machine/include/tune-gfex-zynqmp.inc
UBOOT_MACHINE := "gfex-prototype3b_defconfig"

# add MACHINEOVERRIDES .= ":zcu102-zynqmp" to your machine config otherwise those
# overrides in recipes won't apply since the machine name is different
MACHINEOVERRIDES .= ":gfex-prototype3"
```

## conf/machine/gfex-prototype4.conf
```bitbake
#@TYPE: Machine
#@NAME: Prototype 4
#@DESCRIPTION: Machine support for gFEX Prototype 4

require conf/machine/include/tune-gfex-zynqmp.inc
UBOOT_MACHINE := "gfex-prototype4_defconfig"

# add MACHINEOVERRIDES .= ":zcu102-zynqmp" to your machine config otherwise those
# overrides in recipes won't apply since the machine name is different
MACHINEOVERRIDES .= ":gfex-prototype4"
```

## conf/machine/include/tune-gfex-zynq.inc
```bitbake
# require conf/machine/include/tune-zynq.inc
# require conf/machine/include/zynqmp-generic.conf
require conf/machine/include/tune-gfex.inc

MACHINEOVERRIDES .= ":gfex-zynq"
```

## conf/machine/include/tune-gfex.inc
```bitbake
require conf/machine/include/machine-xilinx-default.inc
require conf/machine/include/xilinx-board.inc
include conf/machine/include/zynqmp-pmu-config.inc

# this is usually something you don't touch, but specify a list of features/tunes
MACHINE_FEATURES = "rtc ext2 ext3 vfat usbhost"
# serial connection with baud rate 115200
SERIAL_CONSOLE = "115200 ttyPS0"
# erase kernel device tree because we want to build our own
KERNEL_DEVICETREE = ""

MACHINEOVERRIDES .= ":gfex"
```

## conf/machine/preprototype.conf
```bitbake
#@TYPE: Machine
#@NAME: Preprototype at BNL
#@DESCRIPTION: Machine support for gFEX Preprototype

require conf/machine/zc706-zynq7.conf

MACHINEOVERRIDES .= ":zc706-zynq7"

MACHINE_DEVICETREE := " \
		preprototype/skeleton.dtsi \
		preprototype/pl.dtsi \
		preprototype/zynq-7000.dtsi \
		preprototype/system.dts \
		"
```

/*
 * CAUTION: This file is automatically generated by Xilinx.
 * Version:  
 * Today is: Fri Feb 16 15:29:26 2018
 */


&gem2 {
	local-mac-address = [00 0a 35 00 00 00];
};
&gem3 {
	local-mac-address = [00 0a 35 00 00 01];
};

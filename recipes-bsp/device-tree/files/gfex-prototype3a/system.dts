/*
 * CAUTION: This file is automatically generated by Xilinx.
 * Version:  
 * Today is: Tue Dec  5 16:03:00 2017
 */


&gem2 {
	local-mac-address = [00 0a 35 00 00 00];
};
&gem3 {
	local-mac-address = [00 0a 35 00 00 01];
};
